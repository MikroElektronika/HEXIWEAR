
/*! *********************************************************************************
*************************************************************************************
* Include
*************************************************************************************
********************************************************************************** */

#include "gui_driver.h"
#include "screens_common.h"
#include "haptic_private.h"
#include "host_mcu_interface.h"
#include "fsl_os_abstraction.h"


/************************************************************************************
*************************************************************************************
* Private type definitions
*************************************************************************************
************************************************************************************/

/*! *********************************************************************************
*************************************************************************************
* Private macros
*************************************************************************************
********************************************************************************** */

/*! @brief Converts milliseconds to ticks*/
#define MSEC_TO_TICK(msec)  (((uint32_t)(msec)+500uL/(uint32_t)configTICK_RATE_HZ) \
                             *(uint32_t)configTICK_RATE_HZ/1000uL)


/*! *********************************************************************************
*************************************************************************************
* Private prototypes
*************************************************************************************
********************************************************************************** */

static void haptic_StateToggleTask(task_param_t param);

/*! *********************************************************************************
*************************************************************************************
* Public memory declarations
*************************************************************************************
********************************************************************************** */

task_handler_t haptic_StateToggleHandler;

/*! *********************************************************************************
*************************************************************************************
* Private memory declarations
*************************************************************************************
********************************************************************************** */

static hostInterface_packet_t haptic_dataPacket =
{
	.start1 = gHostInterface_startByte1,
	.start2 = gHostInterface_startByte2,
	.length = 0,
	.data[0] = gHostInterface_trailerByte
};


static hapticState_t hapticStateCurrent = hapticState_disable;

static mutex_t hapticMutex;

///////////////////////////////////////////////////////////////////////////////////////////////////////////////////////
///////////////////////////////////////////////////////////////////////////////////////////////////////////////////////
///////////////////////////////////////////////////////////////////////////////////////////////////////////////////////

void haptic_Run(void)
{
	VIBRO_ON();
	OSA_TimeDelay(40);
	VIBRO_OFF();
}

void haptic_Vibrate(void)
{
	if ( haptic_CurrentStateGet() == hapticState_enable )
	{
		haptic_MutexLock(OSA_WAIT_FOREVER);
		haptic_Run();
		haptic_MutexUnlock();
	}
}

///////////////////////////////////////////////////////////////////////////////////////////////////////////////////////
///////////////////////////////////////////////////////////////////////////////////////////////////////////////////////
///////////////////////////////////////////////////////////////////////////////////////////////////////////////////////

osa_status_t haptic_MutexCreate(void)
{
	return OSA_MutexCreate( &hapticMutex );
}

///////////////////////////////////////////////////////////////////////////////////////////////////////////////////////
///////////////////////////////////////////////////////////////////////////////////////////////////////////////////////
///////////////////////////////////////////////////////////////////////////////////////////////////////////////////////

osa_status_t haptic_MutexLock(uint32_t timeout)
{
	return OSA_MutexLock( &hapticMutex, timeout );
}

///////////////////////////////////////////////////////////////////////////////////////////////////////////////////////
///////////////////////////////////////////////////////////////////////////////////////////////////////////////////////
///////////////////////////////////////////////////////////////////////////////////////////////////////////////////////

osa_status_t haptic_MutexUnlock(void)
{
	return OSA_MutexUnlock( &hapticMutex );
}

///////////////////////////////////////////////////////////////////////////////////////////////////////////////////////
///////////////////////////////////////////////////////////////////////////////////////////////////////////////////////
///////////////////////////////////////////////////////////////////////////////////////////////////////////////////////
/**
 * [buttonsGroup_Init description]
 * @param param [description]
 */

void haptic_Init( void *param )
{
	if(hapticStateCurrent == hapticState_enable)
	{
		haptic_icon.img = haptic_icon_blue_bmp;
	}
	else
	{
		haptic_icon.img = haptic_icon_white_bmp;
	}

	GuiDriver_ImageAddToScr(&haptic_icon);

	GuiDriver_RegisterForNavigation( GUI_NAVIGATION_RIGHT );
}

///////////////////////////////////////////////////////////////////////////////////////////////////////////////////////
///////////////////////////////////////////////////////////////////////////////////////////////////////////////////////
///////////////////////////////////////////////////////////////////////////////////////////////////////////////////////
/**
 * [buttonsGroup_CreateTasks description]
 * @param param [description]
 */

void haptic_CreateTasks( void *param )
{
	osa_status_t status;


	status = OSA_TaskCreate (
			                      haptic_StateToggleTask,
                                  (uint8_t *) "haptic_ToggleTask",
								  BLUETOOTH_STACK_SIZE,
                                  NULL,
								  BLUETOOTH_PRIO,
                                  (task_param_t)0,
                                  false,
                                  &haptic_StateToggleHandler
                                );

	if ( kStatus_OSA_Success != status )
	{
		catch( CATCH_INIT );
	}
}

///////////////////////////////////////////////////////////////////////////////////////////////////////////////////////
///////////////////////////////////////////////////////////////////////////////////////////////////////////////////////
///////////////////////////////////////////////////////////////////////////////////////////////////////////////////////
/**
 * [buttonsGroup_DestroyTasks description]
 * @param param [description]
 */

void haptic_DestroyTasks( void *param )
{
	osa_status_t status;


	status = OSA_TaskDestroy(haptic_StateToggleHandler);

	if ( kStatus_OSA_Success != status )
	{
		catch( CATCH_INIT );
	}

	OLED_DestroyDynamicArea();
	GuiDriver_UnregisterFromNavigation( GUI_NAVIGATION_RIGHT );
}

///////////////////////////////////////////////////////////////////////////////////////////////////////////////////////
///////////////////////////////////////////////////////////////////////////////////////////////////////////////////////
///////////////////////////////////////////////////////////////////////////////////////////////////////////////////////

hapticState_t haptic_CurrentStateGet(void)
{
	return hapticStateCurrent;
}

///////////////////////////////////////////////////////////////////////////////////////////////////////////////////////
///////////////////////////////////////////////////////////////////////////////////////////////////////////////////////
///////////////////////////////////////////////////////////////////////////////////////////////////////////////////////

/**
 * check if haptic feedback should be enabled at startup
 */
void haptic_CheckAtStartup()
{
	if 	(
				( 1 == HEXIWEAR_FLAGS->isON_Haptic )
			||  ( 0xFF == HEXIWEAR_FLAGS->isON_Haptic )
		)
	{
		hapticStateCurrent = hapticState_enable;
		haptic_icon.img    = haptic_icon_blue_bmp;
	}
}

///////////////////////////////////////////////////////////////////////////////////////////////////////////////////////
///////////////////////////////////////////////////////////////////////////////////////////////////////////////////////
///////////////////////////////////////////////////////////////////////////////////////////////////////////////////////
/**
 * [buttonsGroup_ToggleTask description]
 * @param param [description]
 */

static void haptic_StateToggleTask(task_param_t param)
{
	while(1)
	{
		GuiDriver_QueueMsgGet( &haptic_dataPacket, OSA_WAIT_FOREVER );

	    if(haptic_dataPacket.type == packetType_pressRight)
		{
	    	hapticStateCurrent = (hapticStateCurrent == hapticState_enable) ? hapticState_disable : hapticState_enable;

	    	/** save the current state in flash */
	    	hexiwear_flags_t
	    		hexiwear_stateFlags = {0};
	    	memcpy( (void*)&hexiwear_stateFlags, (const void*)HEXIWEAR_FLAGS, sizeof( hexiwear_stateFlags ) );

            hexiwear_stateFlags.isON_Haptic = hapticStateCurrent;
            HEXIWEAR_SetFlags( (uint32_t)HEXIWEAR_STATE_FLAGS_ADDRESS, (void*)&hexiwear_stateFlags, sizeof(hexiwear_stateFlags) );


		    if(hapticStateCurrent == hapticState_enable)
			{
				haptic_icon.img = haptic_icon_blue_bmp;
				haptic_MutexLock(OSA_WAIT_FOREVER);
				haptic_Run();
				haptic_MutexUnlock();
			}
			else
			{
				haptic_icon.img = haptic_icon_white_bmp;
			}

			GuiDriver_ImageDraw(&haptic_icon);
		}
	}
}

/////////////////////////////////////////////////////////////////////////////////////
/////////////////////////////////////////////////////////////////////////////////////
/////////////////////////////////////////////////////////////////////////////////////
